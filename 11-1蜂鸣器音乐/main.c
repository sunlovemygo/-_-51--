#include <REGX52.H>
#include "Delay.h"
#include "Timer0.h"
#include "LCD1602.h"


sbit Buzzer = P2^5;

// 独立按键引脚
sbit KEY1 = P3^1;
sbit KEY2 = P3^0;

// 频率表（不变）初值 = 65536 - ( 11059200 / 12 / 目标频率 ) / 2
unsigned int code FreqTable[] = {
	0,
	63628,63731,63835,63928,64021,64103,64185, // 低音
	64260,64331,64399,64463,64524,64580,64633, // 中音
	64684,64732,64777,64820,64860,64898,64934, // 高音
};

// ====================== 歌曲1：Bad Apple!! ======================
unsigned char code Music_BadApple[] = {
	19,2,  0,1, 18,1, 17,1, 19,1,
	19,2,  0,1, 18,1, 17,1, 19,1,

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	0xFF, 0
};

// ====================== 歌曲2：天空之城 ======================
unsigned char code Music_Sky[] = {
	17,2,16,2,17,2,20,2,19,4,17,2,16,2,14,2,
	16,4,17,2,16,2,14,2,12,4,12,2,14,2,16,2,17,2,16,2,14,2,12,2,11,2,12,2,
	14,2,12,2,11,2,9,4,9,2,11,2,12,2,11,2,9,2,7,2,9,2,
	11,2,12,2,14,4,17,2,16,2,14,2,12,2,11,2,12,2,
	14,2,12,2,14,2,17,4,16,2,14,2,12,2,11,2,9,2,7,2,9,2,
	11,2,9,2,7,2,5,4,
	0xFF,0
};

// ====================== 歌曲选择 ======================
unsigned char code *MusicList[] = {Music_BadApple, Music_Sky}; // 歌曲列表
unsigned char SongSelect = 0; // 0=BadApple 1=Sky
unsigned char Freq = 0;
unsigned int Time = 0;


unsigned char code Name1[] = " BadApple";
unsigned char code Name2[] = " Sky City";
// 按键扫描
void KeyScan()
{
	if(KEY1 == 0)
	{
		DelayMs(20);
		if(KEY1 == 0)
		{
			SongSelect = 0;  // 按键1 → Bad Apple
			Time = 0;        // 从头播放
			LCD_ShowString(1,1,Name1);
			while(KEY1 == 0);
		}
	}
	
	if(KEY2 == 0)
	{
		DelayMs(20);
		if(KEY2 == 0)
		{
			SongSelect = 1;  // 按键2 → 天空之城
			Time = 0;        // 从头播放
			LCD_ShowString(1,1,Name2);
			while(KEY2 == 0);
		}
	}
}

void main()
{
	Timer0_Init();
	LCD_Init();
	EA = 1;
	LCD_ShowString(1,1,Name1);
	while(1)
	{
		KeyScan();  // 按键切换歌曲
		
		Freq = MusicList[SongSelect][Time++];
		
		if(Freq == 0xFF)
		{
			Time = 0;
			DelayMs(1000);
		}
		else
		{
			Time0_SetCounter(FreqTable[Freq]);
			Time0_Run(1);
			DelayMs(MusicList[SongSelect][Time++]*130);
			Time0_Run(0);
			Buzzer = 1;
			DelayMs(15);
		}
	}
}

void Timer0_Routine() interrupt 1
{
	Time0_SetCounter(FreqTable[Freq]);
	Buzzer = !Buzzer;
}